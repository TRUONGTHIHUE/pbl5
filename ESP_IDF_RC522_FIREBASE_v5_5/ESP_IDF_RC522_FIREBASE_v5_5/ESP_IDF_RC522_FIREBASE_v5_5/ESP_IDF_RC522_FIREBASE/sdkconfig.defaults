## ESP_IDF_RC522_FIREBASE_v5_5/ESP_IDF_RC522_FIREBASE_v5_5/ESP_IDF_RC522_FIREBASE_v5_5/ESP_IDF_RC522_FIREBASE/sdkconfig.defaults
```kconfig
CONFIG_IDF_TARGET="esp32"
CONFIG_MBEDTLS_CERTIFICATE_BUNDLE=y
CONFIG_MBEDTLS_CERTIFICATE_BUNDLE_DEFAULT_FULL=y
CONFIG_ESP_HTTP_CLIENT_ENABLE_HTTPS=y
CONFIG_PARTITION_TABLE_SINGLE_APP_LARGE=y
CONFIG_ESP_MAIN_TASK_STACK_SIZE=4096
```

## PBL5_V6_SPARK/main/Kconfig.projbuild
```kconfig
menu "PBL5 unified - hardware only (no Wi-Fi or Firebase secrets)"
    config PBL5_RC522_SCK
        int "RC522 SCK GPIO"
        default 18
    config PBL5_RC522_MOSI
        int "RC522 MOSI GPIO"
        default 23
    config PBL5_RC522_MISO
        int "RC522 MISO GPIO"
        default 19
    config PBL5_RC522_CS
        int "RC522 SDA/SS GPIO"
        default 21
    config PBL5_RC522_RST
        int "RC522 RST GPIO"
        default 22
endmenu
```

## PBL5_V6_SPARK/sdkconfig.defaults
```kconfig
CONFIG_IDF_TARGET="esp32"
CONFIG_ESPTOOLPY_FLASHSIZE_4MB=y
CONFIG_ESP_CONSOLE_UART_DEFAULT=y
CONFIG_ESP_CONSOLE_UART_BAUDRATE=115200
CONFIG_LOG_DEFAULT_LEVEL_INFO=y
CONFIG_ESP_MAIN_TASK_STACK_SIZE=8192
CONFIG_PARTITION_TABLE_CUSTOM=y
CONFIG_PARTITION_TABLE_CUSTOM_FILENAME="partitions.csv"
```
